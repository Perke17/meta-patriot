## conf/layer.conf
```bitbake
# We have a conf and classes directory, add to BBPATH
BBPATH .= ":${LAYERDIR}"

# We have recipes-* directories, add to BBFILES
BBFILES += "${LAYERDIR}/recipes-*/*/*.bb \
            ${LAYERDIR}/recipes-*/*/*.bbappend"

BBFILE_COLLECTIONS += "meta-patriot"
BBFILE_PATTERN_meta-patriot = "^${LAYERDIR}/"
BBFILE_PRIORITY_meta-patriot = "6"

LAYERDEPENDS_meta-patriot = "core"
LAYERSERIES_COMPAT_meta-patriot = "thud warrior zeus"
```
